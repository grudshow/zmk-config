// Make sure settings.dtsi is included before this file

#define TD_TAPPING_TERM 300

/ {

    behaviors {
			
        lt_num_word: lt_num_word {
            compatible = "zmk,behavior-hold-tap";
            label = "lt_num_word";
            #binding-cells = <2>;
            flavor = "balanced";
            tapping-term-ms = <200>;

            bindings = <&mo>, <&num_word>;
        };
			
	};
};